// mqtt_tls_bench.ino - Stage 2, the pipeline and the key-exchange sweep on the Pico W / Pico 2 W: MQTT 3.1.1 over
//   plain TCP, TLS 1.3 and mutual TLS (wolfSSL 5.9.4, X25519MLKEM768) over Wi-Fi to the Mosquitto brokers of
//   ./run_all.sh --serve-broker on another machine. Same packets, sequence and CSV rows as the host client
//   network/mqtt_tls_timer.c, so run_benchmarks.py summarises them with the host's code:
//     connect  per connection: TCP connect | TLS handshake | MQTT CONNECT..CONNACK, bytes and socket calls
//     pipeline per message:    a 51 B reading sealed in a LoRaWAN data frame (lora_aead.h: none, LoRaWAN 1.0.x /
//                              1.1, AES-256-CTR+CMAC, AES-128/256-GCM, AES-128/256-CCM, Ascon-AEAD128; uplink and
//                              downlink frames), PUBLISHed to the
//                              broker, back down to this client's SUBSCRIBE, verified + decrypted (the host's
//                              --messages run). LoRaWAN / AES / Ascon are measured only this way: through the broker.
//     whole    per pipeline connection: from the TCP connect to the first reading verified (first_ms, the pipeline
//              as a whole in one number) and to the last (all_ms)
//     sweep    per connection, as connect, for every key exchange in GROUPS (the host's tls stage,
//              tls_sweep.sh, against the same listeners): TLS and mTLS
//     kex      (-DMT_KEX_ONLY firmware: only these blocks) the KEM exchange as MQTT messages through the broker's plain
//              listener, as the host's --kex (mqtt_tls_timer.c kem_exchange): per KEM in kem_wolf.h a key pair here,
//              the public key PUBLISHed, the responder next to the broker encapsulates, the ciphertext comes back and
//              is decapsulated here. ML-KEM-512/768/1024, X25519 and the customer's X25519MLKEM768 (wolfCrypt), and
//              HQC-1 (liboqs 0.16; this firmware runs on an 80 KB stack for it)
//   One certificate algorithm per firmware (-DWB_TLS -DWB_<ALG> -DMT_SIG=<certs/ dir>). Round 3 SNOVA (-DWB_SNOVA<set>,
//   certs/round3, the round 3 broker) is wolfSSL's Falcon-512 code carrying liboqs's SNOVA (wolfssl_bench/wb_snova.c);
//   its firmware skips the sweep (-DMT_NO_SWEEP: the groups' cost doesn't depend on the certificate) and runs on a
//   stack big enough for SNOVA's signing (-DMT_STACK_KB, 36-104 KB). mt_secrets.h
//   (Wi-Fi, broker, ports, that CA / client cert / key as DER) is generated by the runner from WIFI_SSID,
//   WIFI_PASS and BROKER; the firmware holds them, so the runner deletes its build.
//   No TCP segment counts (lwIP keeps none per socket): the host's wire_* estimate has no Pico column.
//   Wi-Fi power save is off (as TCP_NODELAY on the host: latency is what is measured).
//   Each connection row also splits the handshake's own crypto on this board (hs_timing.c, --wrap): key share
//   generation, its completion (decapsulation / shared secret), signature verification and signing, with counts.
//   Output: '#block <stage> <mode> [<scheme> <up|down> | <group>]' .. '#end' per block. stage = connect (Stage 2, one
//   row per connection), pipeline (+ one row per message) or sweep; mode = the transport: plain, TLS (server-auth)
//   or mTLS.
//   The run is on a 16 KB painted stack (the Wi-Fi interrupts use it too): '#stack' is the block's peak, 1.5-2.8 KB
//   so far. A hardware watchdog (8 s without progress) reboots a hung board; it then reports '#watchdog <block>:
//   hung during <step> (connection n)' - the step is kept in a watchdog scratch register - and carries on
//   with the next block. Each row also carries the free heap before that connection (a leak = a falling column).
//   -DMT_DEPLOY (with -DWB_CHECKS, certs/DEPLOY from gen_certs.sh --deploy): what a deployed device adds, instead of
//   the benchmark blocks. The board sets its clock by NTP first (certificate and CRL dates are checked), then:
//     connect TLS / mTLS, each also -checked (the CA's CRL and the broker's IP in its certificate), 20 connections;
//     refuse  a wrong broker name, the revoked and the expired server certificate: each must fail;
//     ta      trust-anchor update: the old (classical, ECDSAP256) root can't reach the broker; the signed update is
//             fetched (retained on pqc/ta/update), verified with the update key in firmware, written to flash
//             (LittleFS), read back, and the broker is reached under it;
//     kex     the KEM exchange (ML-KEM-768, X25519MLKEM768) over plain MQTT, over mTLS, and signed (ML-DSA-44 on
//             both messages: the device's client key, the broker's server certificate);
//     fcnt    the LoRaWAN keys, DevAddr and FCnt kept in flash: FCnt reserved FCNT_GAP frames ahead, the board
//             reboots itself, and the next block checks that FCnt went on from the reservation.
//   Each of these prints one '#deploy k=v ...' line (run_benchmarks.py: results/deploy_<tag>.csv).

#include <Arduino.h>
#include <WiFi.h>
#include <wolfssl.h>
#include <wolfssl/ssl.h>
#include <hardware/structs/watchdog.h>  // scratch registers survive a watchdog reboot: which block hung
#include "mt_secrets.h"
#include "lora_aead.h"
#ifdef MT_KEX_ONLY  // + HQC-1 through liboqs 0.16 (kem_wolf.h)
#define KW_LIBOQS
#include <liboqs.h>
#endif
#include "kem_wolf.h"
#include "hs_timing.h"  // the client's crypto inside each handshake (hs_timing.c, linked with --wrap)
#ifdef MT_DEPLOY
#include <LittleFS.h>
#include "deploy_wolf.h"
#endif
#include <wolfssl/wolfcrypt/hash.h>
#ifdef CURVE25519_SMALL  // wolfSSL's small, slow Curve25519 code (-DWB_SMALL_25519, the A/B); default: its normal code
#define X25519_BUILD "_(small_X25519)"  // lib= has no spaces: _ reads as one
#else
#define X25519_BUILD ""
#endif

#if defined(__ARM_ARCH_6M__)
#define CHIP "RP2040"
#else
#define CHIP "RP2350"
#endif
#define STR_(x) #x
#define STR(x) STR_(x)
// the host's defaults: mqtt_bench.py 50 connections + 5 warm-up; pipeline 3 + 1, run_all.sh 200 messages
#ifndef MT_ITERS
#define MT_ITERS 50
#endif
#ifndef MT_WARMUP
#define MT_WARMUP 5
#endif
#ifndef MT_PIPE_ITERS
#define MT_PIPE_ITERS 3
#endif
#ifndef MT_MSGS
#define MT_MSGS 200
#endif
#ifndef MT_PAYLOAD
#define MT_PAYLOAD 51
#endif
// the sweep: fewer than the host's 200 + 20 (a Pico connection takes ~1-2 s; its spread is ~1 %)
#ifndef MT_SWEEP_ITERS
#define MT_SWEEP_ITERS 20
#endif
#ifndef MT_SWEEP_WARMUP
#define MT_SWEEP_WARMUP 2
#endif
// the KEM exchange: the host's --kex-n 50 + 2 warm-up, all on one connection
#ifndef MT_KEX_ITERS
#define MT_KEX_ITERS 50
#endif
#ifndef MT_KEX_WARMUP
#define MT_KEX_WARMUP 2
#endif
// one connection; bytes and socket calls are counted where they cross WiFiClient (raw_send / raw_recv).
// Above the first function: the .ino preprocessor puts its prototypes there.
struct Conn { WiFiClient cl; uint32_t tx = 0, rx = 0, io[2] = {0, 0}; WOLFSSL *tls = nullptr; };
struct Block { const char *stage, *mode; int iters, warm, msgs, aead, down, group; };
struct Group { const char *name; int id; };
// mqtt_bench.SWEEP_GROUPS by their OpenSSL names, those wolfSSL has (not HQC, FrodoKEM)
static const Group GROUPS[] = {
  {"MLKEM512", WOLFSSL_ML_KEM_512}, {"MLKEM768", WOLFSSL_ML_KEM_768}, {"MLKEM1024", WOLFSSL_ML_KEM_1024},
  {"X25519MLKEM768", WOLFSSL_X25519MLKEM768}, {"SecP256r1MLKEM768", WOLFSSL_SECP256R1MLKEM768},
  {"SecP384r1MLKEM1024", WOLFSSL_SECP384R1MLKEM1024},
  {"SecP256r1MLKEM512", WOLFSSL_SECP256R1MLKEM512}, {"x25519_mlkem512", WOLFSSL_X25519MLKEM512},
  {"p384_mlkem768", WOLFSSL_SECP384R1MLKEM768}, {"p521_mlkem1024", WOLFSSL_SECP521R1MLKEM1024},
  {"x448_mlkem768", WOLFSSL_X448MLKEM768},
  {"X25519", WOLFSSL_ECC_X25519}, {"secp256r1", WOLFSSL_ECC_SECP256R1}};
enum { N_GROUPS = sizeof GROUPS / sizeof *GROUPS, G_STAGE2 = 3 };  // Stage 2 / pipeline: X25519MLKEM768
static const char *const MODES[] = {"plain", "TLS", "mTLS"};
#ifdef MT_DEPLOY  // the deployment blocks (see the header), on certs/DEPLOY
enum { R_NAME, R_REVOKED, R_EXPIRED };      // refuse: what must be refused
enum { K_768 = 1, K_HYB = 4, A_LW11 = 2 };  // KW[] and LA[] indices: ML-KEM-768, X25519MLKEM768, lorawan11
static const char *const REFUSE[] = {"wrong-name", "revoked", "expired"};
#ifndef MT_FCNT_MSGS
#define MT_FCNT_MSGS 200
#endif
#define FCNT_GAP 64  // FCnt reserved this far ahead in flash: one flash write per 64 frames
#define WRONG_NAME "192.0.2.1"  // TEST-NET-1: never the broker
#endif
// connect x 3 modes, pipeline x 3 modes x the PIPE schemes x up / down, then sweep x TLS / mTLS x every group
// the pipeline's schemes (LA[] indices): LoRaWAN 1.1, with AES-128 and with 256-bit keys (mqtt_bench.AEADS_DEFAULT);
// -DMT_ALL_SCHEMES: all ten
#ifdef MT_ALL_SCHEMES
static const int PIPE[] = {0, 1, 2, 3, 4, 5, 6, 7, 8, 9};
#else
static const int PIPE[] = {2, 4};  // lorawan11, lorawan11_256
#endif
enum { NP = sizeof PIPE / sizeof *PIPE };
#ifdef MT_KEX_ONLY
enum { N_BLOCKS = KW_N };  // one kex block per KEM
#elif defined(MT_DEPLOY)
enum { N_BLOCKS = 16 };    // DPLAN
#elif defined(MT_NO_SWEEP)
enum { N_BLOCKS = 3 + 3 * NP * 2 };
#else
enum { N_BLOCKS = 3 + 3 * NP * 2 + 2 * N_GROUPS };
#endif
static const uint32_t RESUME_MAGIC = 0x4D515454;  // watchdog scratch[1]: scratch[0] holds a valid block index
static const uint32_t REBOOT_MAGIC = 0x46434E54;  // the same, after the deployment firmware's own reboot (fcnt)
// the step in progress (scratch[2]) and the connection (scratch[3], < 0 = warm-up): a reboot reports where it hung
static const char *const STEPS[] = {"setup", "TCP connect", "TLS handshake", "MQTT CONNECT", "SUBSCRIBE",
                                    "PUBLISH / echo", "TLS close", "TCP close", "serial output", "key pair",
                                    "decapsulation", "flash"};
enum { S_SETUP, S_TCP, S_TLS, S_MQTT, S_SUB, S_PUB, S_TLSCLOSE, S_TCPCLOSE, S_SERIAL, S_KEYGEN, S_DECAPS, S_FLASH };
#define STEP(x) (watchdog_hw->scratch[2] = (x))

// ---- big painted stack + stack-pointer switch, as liboqs_bench (validated on both boards) ----
#ifndef MT_STACK_KB  // -DMT_STACK_KB: SNOVA's signing needs 26-92 KB (run_benchmarks.py)
#ifdef MT_KEX_ONLY
#define MT_STACK_KB 80  // HQC-1's decapsulation needs 65 KB (kem_wolf.h)
#else
#define MT_STACK_KB 16
#endif
#endif
#define STK_PAT 0x5A
static uint8_t g_stk[MT_STACK_KB * 1024u] __attribute__((aligned(16)));
#if defined(__ARM_ARCH_8M_MAIN__) || defined(__ARM_ARCH_8M_BASE__)
__attribute__((naked, noinline)) static int run_on_stack(void *new_top, int (*fn)(void)) {  // M33
  __asm volatile(
    "mrs  r2, msplim       \n"
    "mov  r3, sp           \n"
    "mov  sp, r0           \n"
    "movs r0, #0           \n"
    "msr  msplim, r0       \n"
    "push {r2, r3, r4, lr} \n"
    "blx  r1               \n"
    "pop  {r2, r3, r4, lr} \n"
    "msr  msplim, r2       \n"
    "mov  sp, r3           \n"
    "bx   lr               \n");
}
#else
__attribute__((naked, noinline)) static int run_on_stack(void *new_top, int (*fn)(void)) {  // M0+
  __asm volatile(
    "mov  r2, sp   \n"
    "mov  sp, r0   \n"
    "push {r2, lr} \n"
    "blx  r1       \n"
    "pop  {r2, r3} \n"
    "mov  sp, r2   \n"
    "bx   r3       \n");
}
#endif
static uint32_t stack_peak() {
  uint32_t i = 0; while (i < sizeof g_stk && g_stk[i] == STK_PAT) i++;
  return sizeof g_stk - i;
}

#ifdef MT_KEX_ONLY
static void oqs_rng(uint8_t *out, size_t n) { wb_rand_block(out, (unsigned)n); }  // liboqs (HQC-1): the same hardware RNG
#endif
extern "C" int wb_rand_block(unsigned char *out, unsigned int n) {
  while (n >= 4) { uint32_t r = rp2040.hwrand32(); memcpy(out, &r, 4); out += 4; n -= 4; }
  if (n) { uint32_t r = rp2040.hwrand32(); memcpy(out, &r, n); }
  return 0;
}

// ---- wolfSSL heap accounting (as wolfssl_bench): the peak is the TLS working set ----
static size_t cur_heap, peak_heap;
typedef union { size_t n; long long align; } hdr_t;
static void *wb_malloc(size_t n) {
  hdr_t *h = (hdr_t *)malloc(n + sizeof(hdr_t));
  if (!h) return NULL;
  h->n = n; cur_heap += n; if (cur_heap > peak_heap) peak_heap = cur_heap;
  return h + 1;
}
static void wb_free(void *p) {
  if (!p) return;
  hdr_t *h = (hdr_t *)p - 1; cur_heap -= h->n; free(h);
}
static void *wb_realloc(void *p, size_t n) {
  if (!p) return wb_malloc(n);
  hdr_t *h = (hdr_t *)p - 1; size_t old = h->n;
  hdr_t *nh = (hdr_t *)realloc(h, n + sizeof(hdr_t));
  if (!nh) return NULL;
  nh->n = n; cur_heap = cur_heap - old + n; if (cur_heap > peak_heap) peak_heap = cur_heap;
  return nh + 1;
}

static IPAddress broker;
static char err[160];
#ifdef MT_DEPLOY
static bool cur_checked;                    // this block's connections check the CRL and the broker's name
static const char *cur_name = BROKER;       // the name they expect (the broker's address, or WRONG_NAME)
static uint32_t last_tls_us;                // the last connection's handshake
static const char *(*conn_hook)(Conn *);    // runs on the connection after CONNACK (the trust-anchor fetch)
#endif
static bool kat_ok;  // lora_aead.h's known-answer checks passed: the pipeline's schemes can be trusted

#ifdef MT_DEPLOY
static const Block DPLAN[] = {
  {"connect", "TLS", 20, 2, 0, -1, 0, G_STAGE2}, {"connect", "TLS-checked", 20, 2, 0, -1, 0, G_STAGE2},
  {"connect", "mTLS", 20, 2, 0, -1, 0, G_STAGE2}, {"connect", "mTLS-checked", 20, 2, 0, -1, 0, G_STAGE2},
  {"refuse", "TLS", 1, 0, 0, -1, 0, R_NAME}, {"refuse", "TLS", 1, 0, 0, -1, 0, R_REVOKED},
  {"refuse", "TLS", 1, 0, 0, -1, 0, R_EXPIRED}, {"ta", "TLS", 1, 0, 0, -1, 0, G_STAGE2},
  {"kex", "plain", 1, 0, 0, -1, 0, K_768}, {"kex", "mTLS", 1, 0, 0, -1, 0, K_768}, {"kex", "signed", 1, 0, 0, -1, 0, K_768},
  {"kex", "plain", 1, 0, 0, -1, 0, K_HYB}, {"kex", "mTLS", 1, 0, 0, -1, 0, K_HYB}, {"kex", "signed", 1, 0, 0, -1, 0, K_HYB},
  {"fcnt", "plain", 1, 0, MT_FCNT_MSGS, A_LW11, 0, 0}, {"fcnt", "plain", 1, 0, 50, A_LW11, 0, 1}};
static_assert(sizeof DPLAN / sizeof *DPLAN == N_BLOCKS, "N_BLOCKS = the deployment plan");
#endif
static Block plan(int i) {  // connect; per mode every scheme, uplink then downlink; per mode every group
#ifdef MT_DEPLOY
  return DPLAN[i];
#endif
#ifdef MT_KEX_ONLY
  return {"kex", "plain", 1, 0, 0, -1, 0, i};  // group = the KEM (KW[i]); one connection, MT_KEX_ITERS exchanges
#endif
  if (i < 3) return {"connect", MODES[i], MT_ITERS, MT_WARMUP, 0, -1, 0, G_STAGE2};
  i -= 3;
  if (i < 3 * NP * 2) return {"pipeline", MODES[i / (2 * NP)], MT_PIPE_ITERS, 1, MT_MSGS, PIPE[i / 2 % NP], i % 2, G_STAGE2};
  i -= 3 * NP * 2;
  return {"sweep", MODES[1 + i / N_GROUPS], MT_SWEEP_ITERS, MT_SWEEP_WARMUP, 0, -1, 0, i % N_GROUPS};
}
static const char *label(const Block &b) {  // "connect TLS", "pipeline mTLS lorawan11 down", "sweep TLS MLKEM512"
  static char l[64];
  if (!strcmp(b.stage, "sweep")) snprintf(l, sizeof l, "%s %s %s", b.stage, b.mode, GROUPS[b.group].name);
  else if (!strcmp(b.stage, "kex")) snprintf(l, sizeof l, "%s %s %s", b.stage, b.mode, KW[b.group].name);
#ifdef MT_DEPLOY
  else if (!strcmp(b.stage, "refuse")) snprintf(l, sizeof l, "%s %s %s", b.stage, b.mode, REFUSE[b.group]);
  else if (!strcmp(b.stage, "ta")) snprintf(l, sizeof l, "ta TLS update");
  else if (!strcmp(b.stage, "fcnt")) snprintf(l, sizeof l, "fcnt plain %s", b.group ? "resume" : "save");
#endif
  else if (b.aead < 0) snprintf(l, sizeof l, "%s %s", b.stage, b.mode);
  else snprintf(l, sizeof l, "%s %s %s %s", b.stage, b.mode, LA[b.aead].name, b.down ? "down" : "up");
  return l;
}

static int raw_send(Conn *c, const uint8_t *b, int n) {
  rp2040.wdt_reset();
  int r = (int)c->cl.write(b, n);
  if (r > 0) { c->tx += r; c->io[0]++; }
  return r;
}
static int raw_recv(Conn *c, uint8_t *b, int n) {  // 0 = closed, -1 = 10 s silence (the host's SO_RCVTIMEO)
  rp2040.wdt_reset();  // also with the data already here: SNOVA level V verifies twice (2 x 3.5 s) between waits
  for (uint32_t t0 = millis(); !c->cl.available();) {
    rp2040.wdt_reset();
    if (!c->cl.connected()) return 0;
    if (millis() - t0 > 10000) return -1;
  }
  int r = c->cl.read(b, n);
  if (r > 0) { c->rx += r; c->io[1]++; }
  return r;
}
static int cb_send(WOLFSSL *, char *b, int n, void *c) {
  int r = raw_send((Conn *)c, (const uint8_t *)b, n);
  return r > 0 ? r : WOLFSSL_CBIO_ERR_CONN_CLOSE;
}
static int cb_recv(WOLFSSL *, char *b, int n, void *c) {
  int r = raw_recv((Conn *)c, (uint8_t *)b, n);
  return r > 0 ? r : r == 0 ? WOLFSSL_CBIO_ERR_CONN_CLOSE : WOLFSSL_CBIO_ERR_TIMEOUT;
}
static const char *tls_err(Conn *c, int r) {
  static char e[WOLFSSL_MAX_ERROR_SZ];
  return c->tls ? wolfSSL_ERR_error_string(wolfSSL_get_error(c->tls, r), e) : "connection closed by broker";
}

// ---- MQTT, as mqtt_tls_timer.c ----
static int io_write(Conn *c, const uint8_t *b, int n) { return c->tls ? wolfSSL_write(c->tls, b, n) : raw_send(c, b, n); }
static int io_read_n(Conn *c, uint8_t *b, int n) {
  for (int got = 0, r; got < n; got += r)
    if ((r = c->tls ? wolfSSL_read(c->tls, b + got, n - got) : raw_recv(c, b + got, n - got)) <= 0) return r;
  return n;
}
static int read_packet(Conn *c, uint8_t *type, uint8_t *body, int cap) {  // body length, -1 on error
  int len = 0, shift = 0;
  uint8_t b;
  if (io_read_n(c, type, 1) != 1) return -1;
  do {
    if (io_read_n(c, &b, 1) != 1 || shift > 21) return -1;
    len |= (b & 0x7F) << shift; shift += 7;
  } while (b & 0x80);
  return len <= cap && io_read_n(c, body, len) == len ? len : -1;
}
static int put_len(uint8_t *p, int len) {
  int n = 0;
  do { p[n] = len & 0x7F; len >>= 7; if (len) p[n] |= 0x80; n++; } while (len);
  return n;
}
static int connect_packet(uint8_t *p, const char *id, int keepalive) {
  int il = (int)strlen(id), n = 0;
  p[n++] = 0x10; n += put_len(p + n, 10 + 2 + il);
  memcpy(p + n, "\0\4MQTT\4\2", 8); n += 8;
  p[n++] = keepalive >> 8; p[n++] = keepalive & 0xFF;
  p[n++] = il >> 8; p[n++] = il & 0xFF; memcpy(p + n, id, il);
  return n + il;
}
static bool subscribe(Conn *c, const char *filter) {  // QoS 0, packet id 1, waits for SUBACK
  static uint8_t pkt[128], body[16];
  int tl = (int)strlen(filter), n = 0;
  uint8_t type;
  pkt[n++] = 0x82; n += put_len(pkt + n, 2 + 2 + tl + 1);
  pkt[n++] = 0; pkt[n++] = 1;
  pkt[n++] = tl >> 8; pkt[n++] = tl & 0xFF; memcpy(pkt + n, filter, tl); n += tl;
  pkt[n++] = 0;
  return io_write(c, pkt, n) == n && read_packet(c, &type, body, sizeof body) >= 0 && type == 0x90;
}

#ifdef MT_DEPLOY
// the LoRaWAN state in flash (/lora.bin): DevAddr, keys and an FCnt reservation. Frames below the reservation may
// have been sent; the board saves a new one FCNT_GAP frames ahead before it reaches it, so after any reboot or crash
// FCnt resumes at the saved value and never repeats under these keys (one flash write per FCNT_GAP frames).
struct LoraState { uint32_t magic, fcnt; uint8_t devaddr[4], k_app[32], k_nwk[16], k_nwk2[16]; };
static const uint32_t LORA_MAGIC = 0x4C57534B;
static uint32_t fcnt_reserved, save_us[16], nsaves;
static bool fcnt_persist;  // the fcnt blocks: save reservations while sending
static bool lora_save(uint32_t upto) {
  LoraState st = {LORA_MAGIC, upto, {}, {}, {}, {}};
  memcpy(st.devaddr, devaddr, 4); memcpy(st.k_app, k_app, 32); memcpy(st.k_nwk, k_nwk, 16); memcpy(st.k_nwk2, k_nwk2, 16);
  File f = LittleFS.open("/lora.bin", "w");
  bool ok = f && f.write((const uint8_t *)&st, sizeof st) == sizeof st;
  if (f) f.close();
  if (ok) fcnt_reserved = upto;
  return ok;
}
static bool lora_load() {  // true: keys, DevAddr and FCnt (= the saved reservation) are back
  LoraState st;
  File f = LittleFS.open("/lora.bin", "r");
  bool ok = f && f.read((uint8_t *)&st, sizeof st) == sizeof st && st.magic == LORA_MAGIC;
  if (f) f.close();
  if (!ok) return false;
  memcpy(devaddr, st.devaddr, 4); memcpy(k_app, st.k_app, 32); memcpy(k_nwk, st.k_nwk, 16); memcpy(k_nwk2, st.k_nwk2, 16);
  fcnt = st.fcnt;
  return true;
}
#endif

// the pipeline: seal a reading with the block's scheme (lora_aead.h; the frame, FCnt and direction as the host's
// app_seal), PUBLISH it, wait for the broker to deliver it back, then verify + decrypt it (app_open)
static char topic[32];
static int cur_aead;
// t_conn: when this connection's TCP connect started (micros): the 'whole' row (the pipeline as a whole)
static const char *pipeline(Conn *c, int iter, int msgs, bool report, uint32_t t_conn) {
  uint32_t first = 0;
  static uint8_t pkt[64 + sizeof frame], body[64 + sizeof frame];
  const la_scheme &sc = LA[cur_aead];
  int tl = (int)strlen(topic), fl = HDR + MT_PAYLOAD + sc.tag;
  uint8_t type;
  STEP(S_SUB);
  if (!subscribe(c, topic)) return "mqtt subscribe failed: no SUBACK";
  for (int m = 0; m < msgs; m++) {
    char s[48];
    int sl = snprintf(s, sizeof s, "{\"seq\":%lu,\"temp_c\":21.5,\"rh\":48}", (unsigned long)(fcnt + 1));
    memset(pt, ' ', MT_PAYLOAD);
    memcpy(pt, s, sl < MT_PAYLOAD ? sl : MT_PAYLOAD);
#ifdef MT_DEPLOY
    if (fcnt_persist && fcnt + 1 >= fcnt_reserved) {  // reserve the next FCNT_GAP frames before sending this one
      STEP(S_FLASH);
      uint32_t s0 = micros();
      if (!lora_save(fcnt + 1 + FCNT_GAP)) return "flash write failed (LittleFS)";
      save_us[nsaves++ % 16] = micros() - s0;
    }
#endif
    uint32_t t0 = micros();
    if (sc.seal(MT_PAYLOAD)) return "seal failed";
    uint32_t t1 = micros();
    int h = 0;
    pkt[h++] = 0x30; h += put_len(pkt + h, 2 + tl + fl);
    pkt[h++] = tl >> 8; pkt[h++] = tl & 0xFF;
    memcpy(pkt + h, topic, tl); memcpy(pkt + h + tl, frame, fl);
    int n = h + tl + fl, len;
    uint32_t tx0 = c->tx, rx0 = c->rx;
    STEP(S_PUB);
    if (io_write(c, pkt, n) != n) return "mqtt publish failed: write";
    do len = read_packet(c, &type, body, sizeof body);  // skip anything that isn't our PUBLISH
    while (len >= 0 && (type & 0xF0) != 0x30);
    uint32_t t2 = micros();
    if (len < 2) return "mqtt publish failed: no echo from broker";
    int off = 2 + (body[0] << 8 | body[1]);
    bool ok = len - off == fl;
    if (ok) { memcpy(frame, body + off, fl); ok = sc.open(MT_PAYLOAD) == 0 && !memcmp(out, pt, MT_PAYLOAD); }
    uint32_t t3 = micros();
    if (!ok) { snprintf(err, sizeof err, "payload verification failed: %s", sc.name); return err; }
    if (m == 0) first = micros() - t_conn;
    STEP(S_SERIAL);
    if (report) Serial.printf("msg,%d,%d,%lu,%lu,%lu,%lu,%lu\n", iter, m, (unsigned long)(t1 - t0),
                              (unsigned long)(t2 - t1), (unsigned long)(t3 - t2),
                              (unsigned long)(c->tx - tx0), (unsigned long)(c->rx - rx0));
  }
  if (report && msgs > 0)
    Serial.printf("whole,%d,%.3f,%.3f,%d\n", iter, first / 1e3, (micros() - t_conn) / 1e3, msgs);
  return nullptr;
}

// the KEM exchange, as mqtt_tls_timer.c kem_exchange: a key pair here, the public key PUBLISHed on
// pqc/kem/<id>/pk/<KEM>, the responder replies on pqc/kem/<id>/ct with ciphertext | SHA-256(secret) | its
// encapsulation time (4 B LE, us); decapsulate and compare the hashes (key confirmation). Rows as the host's:
//   kex,iter,idx,keygen_us,rtt_us,decaps_us,encaps_us,tx_B,rx_B    (rtt: PUBLISH of the key -> ciphertext back)
static int cur_kem = -1;
#if defined(MT_KEX_ONLY) || defined(MT_DEPLOY)  // only in those firmwares: the TLS ones stay as they were measured
#ifdef MT_DEPLOY
// signed (mode "signed"): the public key goes to pqc/kem/<id>/spk/<KEM> as pk | ML-DSA-44 signature by the client
// key; the reply is ct | hash | encaps time | the responder's signature over those bytes and pk (server.crt's key)
static bool cur_signed;
static dp_key dev_key, srv_key;
enum { SIG_MAX = 2420 };
#else
enum { SIG_MAX = 0 };
#endif
static const char *kem_exchange(Conn *c) {
  static kw_state s;  // static: the ML-KEM key is kilobytes, the block runs on a 16 KB stack
  static WC_RNG rng;
  static uint8_t pk[KW_MAX + SIG_MAX], ss[64], h[WC_SHA256_DIGEST_SIZE], pkt[KW_MAX + SIG_MAX + 96],
                 body[KW_MAX + SIG_MAX + 96];
  char pk_topic[64], ct_topic[48];
#ifdef MT_DEPLOY
  static uint8_t m[2 * KW_MAX + 40];  // what the responder signed: its reply and our key
  const bool sg = cur_signed;
#else
  const bool sg = false;
#endif
  snprintf(pk_topic, sizeof pk_topic, "pqc/kem/%s/%s/%s", topic + 9, sg ? "spk" : "pk", KW[cur_kem].name);  // topic + 9 = "pico-<devaddr>"
  snprintf(ct_topic, sizeof ct_topic, "pqc/kem/%s/ct", topic + 9);
  if (wc_InitRng(&rng) || kw_init(&s, cur_kem, &rng)) return "wolfCrypt RNG / ML-KEM init failed";
  Serial.printf("#kem %s lib=wolfSSL_%s%s pk_B=%lu ct_B=%lu ss_B=%lu nist_level=%d\n", s.k->name,
                LIBWOLFSSL_VERSION_STRING, s.k->x25519 ? X25519_BUILD : "", (unsigned long)s.pk, (unsigned long)s.ct,
                (unsigned long)s.ss, s.k->level);
  Serial.println(sg ? "kex,iter,idx,keygen_us,rtt_us,decaps_us,encaps_us,tx_B,rx_B,sign_us,verify_us"
                    : "kex,iter,idx,keygen_us,rtt_us,decaps_us,encaps_us,tx_B,rx_B");
  const char *e = nullptr;
  int tl = (int)strlen(pk_topic);
  STEP(S_SUB);
  if (!subscribe(c, ct_topic)) e = "mqtt subscribe failed: no SUBACK";
  for (int x = 0; x < MT_KEX_WARMUP + MT_KEX_ITERS && !e; x++) {
    rp2040.wdt_reset();
    watchdog_hw->scratch[3] = (uint32_t)(x - MT_KEX_WARMUP);
    STEP(S_KEYGEN);
    uint32_t t0 = micros();
    if (kw_keypair(&s, pk)) { e = "key pair failed"; break; }
    uint32_t ta = micros(), sign_us = 0, verify_us = 0;
    size_t pl = s.pk;
#ifdef MT_DEPLOY
    if (sg) {  // pk | signature
      size_t sl = SIG_MAX;
      if (dp_sign(&dev_key, &rng, pk, s.pk, pk + s.pk, &sl)) { e = "signing the public key failed"; break; }
      pl += sl;
      sign_us = micros() - ta;
    }
#endif
    int n = 0, len;
    pkt[n++] = 0x30; n += put_len(pkt + n, 2 + tl + (int)pl);
    pkt[n++] = tl >> 8; pkt[n++] = tl & 0xFF; memcpy(pkt + n, pk_topic, tl); memcpy(pkt + n + tl, pk, pl);
    n += tl + (int)pl;
    uint8_t type;
    uint32_t tx0 = c->tx, rx0 = c->rx;
    STEP(S_PUB);
    uint32_t t1 = micros();
    if (io_write(c, pkt, n) != n) { e = "mqtt publish failed: write"; break; }
    do len = read_packet(c, &type, body, sizeof body);  // skip anything that isn't the reply
    while (len >= 0 && (type & 0xF0) != 0x30);
    uint32_t t2 = micros();
    if (len < 2) { e = "kem exchange failed: no reply (is the responder running next to the broker?)"; break; }
    int off = 2 + (body[0] << 8 | body[1]);
    const uint8_t *r = body + off;
    if (sg ? len - off <= (int)s.ct + 36 : len - off != (int)s.ct + 36) { e = "kem exchange failed: reply has the wrong length"; break; }
#ifdef MT_DEPLOY
    if (sg) {  // the responder's signature over its reply and our public key
      uint32_t v0 = micros();
      memcpy(m, r, s.ct + 36); memcpy(m + s.ct + 36, pk, s.pk);
      if (dp_verify(&srv_key, m, s.ct + 36 + s.pk, r + s.ct + 36, len - off - (s.ct + 36))) {
        e = "kem exchange failed: the responder's signature does not verify"; break;
      }
      verify_us = micros() - v0;
    }
#endif
    STEP(S_DECAPS);
    uint32_t td = micros();  // after the signature check (signed): decaps_us is decapsulation only
    if (kw_decaps(&s, ss, r)) { e = "decapsulation failed"; break; }
    uint32_t t3 = micros();
    wc_Sha256Hash(ss, s.ss, h);
    if (memcmp(h, r + s.ct, 32)) { e = "kem exchange failed: the shared secrets differ"; break; }
    const uint8_t *en = r + s.ct + 32;
    STEP(S_SERIAL);
    if (x >= MT_KEX_WARMUP) {
      Serial.printf("kex,0,%d,%lu,%lu,%lu,%lu,%lu,%lu", x - MT_KEX_WARMUP, (unsigned long)(ta - t0),
                    (unsigned long)(t2 - t1), (unsigned long)(t3 - td),
                    (unsigned long)(en[0] | en[1] << 8 | en[2] << 16 | (uint32_t)en[3] << 24),
                    (unsigned long)(c->tx - tx0), (unsigned long)(c->rx - rx0));
      if (sg) Serial.printf(",%lu,%lu", (unsigned long)sign_us, (unsigned long)verify_us);
      Serial.println();
    }
  }
  kw_free(&s);
  wc_FreeRng(&rng);
  return e;
}
#endif

// ---- one connection: timed like mqtt_tls_timer.c's main loop; iter < 0 = warm-up (not printed) ----
static const char *one_connection(WOLFSSL_CTX *ctx, uint16_t port, int iter, int msgs, int group) {
  static const uint8_t disconnect_pkt[] = {0xE0, 0};
  static uint8_t connect_pkt[32];
  static int connect_len = connect_packet(connect_pkt, "pqc-timer", 60);  // the host's 23-byte CONNECT
  rp2040.wdt_reset();
  watchdog_hw->scratch[3] = (uint32_t)iter;
  int free_heap = rp2040.getFreeHeap();
  Conn c;
  const char *e = nullptr;
  uint32_t t0 = micros(), t1 = 0, t2 = 0, t3 = 0, hs_tx = 0, hs_rx = 0, hs_w = 0, hs_r = 0;
  do {
    STEP(S_TCP);
    if (!c.cl.connect(broker, port)) { e = "tcp connect failed (no listener?)"; break; }
    c.cl.setNoDelay(true);
    t1 = micros();
    hs_reset();
    if (ctx) {
      int g = GROUPS[group].id, r;
      if (!(c.tls = wolfSSL_new(ctx))) { e = "wolfSSL_new failed (out of memory?)"; break; }
      wolfSSL_SetIOReadCtx(c.tls, &c); wolfSSL_SetIOWriteCtx(c.tls, &c);
#ifdef MT_DEPLOY
      if (cur_checked && dp_checks_ssl(c.tls, cur_name)) { e = "cannot set the expected broker name"; break; }
#endif
      if (wolfSSL_set_groups(c.tls, &g, 1) != WOLFSSL_SUCCESS || wolfSSL_UseKeyShare(c.tls, g) != WOLFSSL_SUCCESS) {
        e = "group not usable by this wolfSSL build"; break;
      }
      STEP(S_TLS);
      if ((r = wolfSSL_connect(c.tls)) != WOLFSSL_SUCCESS) {
        snprintf(err, sizeof err, "tls handshake failed: %s", tls_err(&c, r)); e = err; break;
      }
    }
    t2 = micros();
#ifdef MT_DEPLOY
    last_tls_us = t2 - t1;
#endif
    hs_times_t hs = hs_t;  // before the MQTT CONNECT: only the handshake's crypto
    hs_tx = c.tx; hs_rx = c.rx; hs_w = c.io[0]; hs_r = c.io[1];
    uint8_t ack[4];
    int r = 0;
    STEP(S_MQTT);
    if (io_write(&c, connect_pkt, connect_len) != connect_len || (r = io_read_n(&c, ack, 4)) != 4) {
      snprintf(err, sizeof err, "mqtt connect failed: %s", tls_err(&c, r)); e = err; break;
    }
    if (ack[0] != 0x20 || ack[3] != 0) {
      snprintf(err, sizeof err, "mqtt connect refused: CONNACK return code %d", ack[3]); e = err; break;
    }
    t3 = micros();
    STEP(S_SERIAL);
    if (iter == 0 && c.tls) Serial.printf("#suite %s\n", wolfSSL_get_cipher_name(c.tls));
    if (iter >= 0)
      Serial.printf("%d,%.4f,%.4f,%.4f,%.4f,%lu,%lu,%lu,%lu,%lu,%lu,%lu,%lu,%d" HS_FMT "\n", iter, (t1 - t0) / 1e3,
                    (t2 - t1) / 1e3, (t3 - t2) / 1e3, (t3 - t0) / 1e3, (unsigned long)hs_tx, (unsigned long)hs_rx,
                    (unsigned long)(c.tx - hs_tx), (unsigned long)(c.rx - hs_rx), (unsigned long)hs_w,
                    (unsigned long)hs_r, (unsigned long)c.io[0], (unsigned long)c.io[1], free_heap, HS_ARGS(hs));
    if (msgs > 0) e = pipeline(&c, iter, msgs, iter >= 0, t0);
#if defined(MT_KEX_ONLY) || defined(MT_DEPLOY)
    if (!e && cur_kem >= 0 && iter >= 0) e = kem_exchange(&c);
#endif
#ifdef MT_DEPLOY
    if (!e && conn_hook) e = conn_hook(&c);
#endif
    STEP(S_TLSCLOSE);
    if (!e) io_write(&c, disconnect_pkt, sizeof disconnect_pkt);
  } while (0);
  STEP(S_TLSCLOSE);
  if (c.tls) { if (!e) wolfSSL_shutdown(c.tls); wolfSSL_free(c.tls); }
  STEP(S_TCPCLOSE);
  c.cl.stop();
  STEP(S_SETUP);
  return e;
}

// a TLS 1.3 client context: this CA, mTLS's client cert + key, the deployment's CRL; *e = why it failed
static WOLFSSL_CTX *new_ctx(const uint8_t *ca, size_t ca_n, bool mtls, bool crl, const char **e) {
  WOLFSSL_CTX *ctx = wolfSSL_CTX_new(wolfTLSv1_3_client_method());
  if (!ctx) { *e = "wolfSSL_CTX_new failed (out of memory?)"; return nullptr; }
  if (wolfSSL_CTX_load_verify_buffer(ctx, ca, (long)ca_n, WOLFSSL_FILETYPE_ASN1) != WOLFSSL_SUCCESS)
    *e = "cannot load CA cert: signature algorithm unsupported by this TLS library build?";
  else if (mtls && (wolfSSL_CTX_use_certificate_buffer(ctx, CRT_DER, sizeof CRT_DER, WOLFSSL_FILETYPE_ASN1) != WOLFSSL_SUCCESS ||
                    wolfSSL_CTX_use_PrivateKey_buffer(ctx, KEY_DER, sizeof KEY_DER, WOLFSSL_FILETYPE_ASN1) != WOLFSSL_SUCCESS))
    *e = "cannot load client cert/key: signature algorithm unsupported by this TLS library build?";
#ifdef MT_DEPLOY
  else if (crl && dp_checks_ctx(ctx, CRL_DER, sizeof CRL_DER)) *e = "cannot load the CA's CRL";
#else
  (void)crl;
#endif
  wolfSSL_CTX_set_verify(ctx, WOLFSSL_VERIFY_PEER, NULL);
  wolfSSL_CTX_SetIORecv(ctx, cb_recv);
  wolfSSL_CTX_SetIOSend(ctx, cb_send);
  return ctx;
}

#ifdef MT_DEPLOY
// refuse: one connection that must fail; its reason goes to '#reason'
static const char *refuse_block(WOLFSSL_CTX *ctx, uint16_t port, const char *what) {
  const char *r = one_connection(ctx, port, -1, 0, G_STAGE2);
  if (!r) return "accepted: it should have been refused";
  Serial.printf("#reason %s\n#deploy refused=1 case=%s\n", r, what);
  return nullptr;
}

// the trust-anchor update (see the header); the retained update arrives right after the SUBACK
static uint8_t ta_buf[8192];
static size_t ta_len;
static const char *ta_fetch(Conn *c) {
  uint8_t type;
  int len;
  if (!subscribe(c, "pqc/ta/update")) return "mqtt subscribe failed: no SUBACK";
  do len = read_packet(c, &type, ta_buf, sizeof ta_buf);
  while (len >= 0 && (type & 0xF0) != 0x30);
  if (len < 2) return "no trust-anchor update on pqc/ta/update (run the broker side with certs/DEPLOY)";
  int off = 2 + (ta_buf[0] << 8 | ta_buf[1]);
  ta_len = len - off;
  memmove(ta_buf, ta_buf + off, ta_len);
  return nullptr;
}
static const char *ta_block() {
  static uint8_t ca[6144];
  const char *e = nullptr, *r;
  WOLFSSL_CTX *ctx = new_ctx(OLD_CA_DER, sizeof OLD_CA_DER, false, false, &e);  // the root it shipped with
  if (!e) r = one_connection(ctx, PORT_TLS, -1, 0, G_STAGE2);
  if (ctx) wolfSSL_CTX_free(ctx);
  if (e) return e;
  if (!r) return "the old root reached the PQ broker: it should not have";
  Serial.printf("#reason before the update: %s\n", r);
  conn_hook = ta_fetch;
  uint32_t f0 = micros();
  r = one_connection(nullptr, PORT_PLAIN, -1, 0, G_STAGE2);
  uint32_t fetch_us = micros() - f0;
  conn_hook = nullptr;
  if (r) return r;
  size_t ca_n = 0, dummy;
  uint32_t v0 = micros();
  int off = dp_ta_verify(ta_buf, ta_len, UPD_PUB, sizeof UPD_PUB, &ca_n);
  uint32_t verify_us = micros() - v0;
  if (off < 0) return "the trust-anchor update does not verify";
  ta_buf[ta_len - 1] ^= 1;  // one changed byte (in the signature) must fail
  bool tamper = dp_ta_verify(ta_buf, ta_len, UPD_PUB, sizeof UPD_PUB, &dummy) < 0;
  ta_buf[ta_len - 1] ^= 1;
  STEP(S_FLASH);
  uint32_t w0 = micros();
  File f = LittleFS.open("/ta.der", "w");
  bool ok = f && f.write(ta_buf + off, ca_n) == ca_n;
  if (f) f.close();
  uint32_t write_us = micros() - w0, r0 = micros();
  f = LittleFS.open("/ta.der", "r");
  size_t got = f ? f.read(ca, sizeof ca) : 0;
  if (f) f.close();
  uint32_t read_us = micros() - r0;
  if (!ok) return "flash write failed (LittleFS)";
  if (got != ca_n || memcmp(ca, ta_buf + off, ca_n)) return "the CA read back from flash differs";
  ctx = new_ctx(ca, got, false, true, &e);  // the new root, with the CRL it issued
  if (!e) r = one_connection(ctx, PORT_TLS, -1, 0, G_STAGE2);
  if (ctx) wolfSSL_CTX_free(ctx);
  if (e || r) { snprintf(err, sizeof err, "with the new root: %s", e ? e : r); return err; }
  Serial.printf("#deploy before=refused bundle_B=%u ca_B=%u fetch_ms=%.1f verify_us=%lu tamper_refused=%d "
                "flash_write_us=%lu flash_read_us=%lu after=accepted tls_ms=%.1f\n", (unsigned)ta_len, (unsigned)ca_n,
                fetch_us / 1e3, (unsigned long)verify_us, tamper, (unsigned long)write_us, (unsigned long)read_us,
                last_tls_us / 1e3);
  return nullptr;
}

static uint32_t boot_fcnt, last_before_reboot;  // set in setup(): FCnt at boot, the last FCnt before the reboot
static void fcnt_report(const Block &b, uint32_t start) {
  char da[9];
  snprintf(da, sizeof da, "%02x%02x%02x%02x", devaddr[0], devaddr[1], devaddr[2], devaddr[3]);
  if (b.group) {  // resume: FCnt must go on past the last frame sent before the reboot
    Serial.printf("#deploy devaddr=%s last_before_reboot=%lu resumed_at=%lu continues=%d fcnt_last=%lu\n", da,
                  (unsigned long)last_before_reboot, (unsigned long)boot_fcnt, boot_fcnt > last_before_reboot,
                  (unsigned long)fcnt);
    return;
  }
  uint32_t n = nsaves < 16 ? nsaves : 16, srt[16], mx = 0;
  memcpy(srt, save_us, n * sizeof *srt);
  for (uint32_t i = 1; i < n; i++) { uint32_t k = srt[i]; int j = (int)i - 1; while (j >= 0 && srt[j] > k) { srt[j + 1] = srt[j]; j--; } srt[j + 1] = k; }
  for (uint32_t i = 0; i < n; i++) mx = srt[i] > mx ? srt[i] : mx;
  Serial.printf("#deploy devaddr=%s fcnt_start=%lu fcnt_last=%lu reserved=%lu gap=%d saves=%lu save_us_median=%lu "
                "save_us_max=%lu\n", da, (unsigned long)start, (unsigned long)fcnt, (unsigned long)fcnt_reserved,
                FCNT_GAP, (unsigned long)nsaves, (unsigned long)(n ? srt[n / 2] : 0), (unsigned long)mx);
}
#endif

// ---- one block = the host's run_timer() for one (stage, mode[, scheme, direction]): '#block' .. '#end' ----
static void bench_block(const Block &b) {
  const char *mode = b.mode;
  int iters = b.iters, warm = b.warm, msgs = b.msgs;
  bool tls = strcmp(mode, "plain") && strcmp(mode, "signed"), mtls = !strncmp(mode, "mTLS", 4), crl = false;
  cur_kem = !strcmp(b.stage, "kex") ? b.group : -1;
  uint16_t port = !tls ? PORT_PLAIN : mtls ? PORT_MTLS : PORT_TLS;
  const char *e = nullptr;
  WOLFSSL_CTX *ctx = nullptr;
#ifdef MT_DEPLOY
  bool refuse = !strcmp(b.stage, "refuse"), ta = !strcmp(b.stage, "ta"), fc = !strcmp(b.stage, "fcnt");
  crl = cur_checked = strstr(mode, "-checked") || refuse || ta;
  cur_name = refuse && b.group == R_NAME ? WRONG_NAME : BROKER;
  cur_signed = !strcmp(mode, "signed");
  fcnt_persist = fc;
  nsaves = 0;
  uint32_t fcnt_start = fcnt;
  if (refuse && b.group == R_REVOKED) port = PORT_REVOKED;
  if (refuse && b.group == R_EXPIRED) port = PORT_EXPIRED;
  if (ta) tls = false;  // ta_block makes its own contexts
#endif
  peak_heap = cur_heap;
  Serial.printf("#block %s\n", label(b));
  if (msgs > 0) {
    cur_aead = b.aead; down = b.down;
    la_setup(cur_aead);
    Serial.printf("#aead %s (%s), %s, %d B payload + %d B overhead\n", LA[cur_aead].label, LA[cur_aead].lib,
                  down ? "downlink" : "uplink", MT_PAYLOAD, HDR + LA[cur_aead].tag);
    if (!kat_ok && cur_aead) e = "LoRaWAN / AES / Ascon known-answer check failed on this board: not sending";
  }
  if (tls && !e) ctx = new_ctx(CA_DER, sizeof CA_DER, mtls, crl, &e);
  Serial.printf("#lib %s\n", tls ? "wolfSSL " LIBWOLFSSL_VERSION_STRING : "none (plain MQTT)");
  Serial.println("iter,tcp_ms,tls_ms,mqtt_ms,total_ms,hs_tx_B,hs_rx_B,mqtt_tx_B,mqtt_rx_B,hs_writes,hs_reads,writes,reads,"
                 "free_heap_B," HS_COLS);
  if (msgs > 0) Serial.println("msg,iter,idx,seal_us,rtt_us,open_us,tx_B,rx_B\nwhole,iter,first_ms,all_ms,msgs");
#ifdef MT_DEPLOY
  if (cur_signed && !e && (dp_key_private(&dev_key, KEY_DER, sizeof KEY_DER) ||
                           dp_key_cert(&srv_key, SRV_DER, sizeof SRV_DER, CA_DER, sizeof CA_DER)))
    e = "cannot load the signing keys (client.key, server.crt against CA.crt)";
  if (fc && b.group) fcnt_report(b, fcnt_start);
  if (e) ;
  else if (refuse) e = refuse_block(ctx, port, REFUSE[b.group]);
  else if (ta) e = ta_block();
  else
#endif
  for (int i = 0; i < warm + iters && !e; i++) e = one_connection(ctx, port, i - warm, msgs, b.group);
#ifdef MT_DEPLOY
  if (fc && !b.group && !e) fcnt_report(b, fcnt_start);
  if (cur_signed) { dp_key_free(&dev_key); dp_key_free(&srv_key); }
  fcnt_persist = false;
#endif
  if (e) Serial.printf("#err %s\n", e);
  if (tls) Serial.printf("#heap %u\n", (unsigned)peak_heap);
  Serial.printf("#stack %lu\n", (unsigned long)stack_peak());
  Serial.println("#end");
  if (ctx) wolfSSL_CTX_free(ctx);
#ifdef MT_DEPLOY
  if (fc && !b.group && !e) {  // the FCnt test: reboot now, the next block reports how FCnt resumed
    watchdog_hw->scratch[3] = fcnt;
    watchdog_hw->scratch[1] = REBOOT_MAGIC;  // scratch[0] = this block (setup() carries on with the next)
    Serial.println("#reboot the deployment firmware reboots itself: FCnt must resume from flash");
    Serial.flush();
    delay(200);
    rp2040.reboot();
  }
#endif
}

static int cur_block;
static int run_block() {
  bench_block(plan(cur_block));
  return 0;
}

#ifdef MT_DEPLOY
static bool ntp_ok() {  // certificate and CRL dates need the time: NTP before any handshake
  NTP.begin(NTP_SERVER);
  if (!NTP.waitSet(30000)) return false;
  Serial.printf("#time %lu (NTP %s): certificate and CRL dates are checked\n", (unsigned long)time(nullptr), NTP_SERVER);
  return true;
}
#endif

void setup() {
  Serial.begin(115200);
  while (!Serial) delay(10);
  delay(200);
  wolfSSL_SetAllocators(wb_malloc, wb_free, wb_realloc);
  wolfSSL_Init();
#ifdef MT_KEX_ONLY
  OQS_init();
  OQS_randombytes_custom_algorithm(oqs_rng);
#endif
  Serial.printf("=== MQTT / TLS 1.3 / mTLS, " STR(MT_SIG) " certificates, X25519MLKEM768 (wolfSSL %s) on " CHIP " ===\n",
                LIBWOLFSSL_VERSION_STRING);
  Serial.printf("CPU clock: %lu MHz\n", (unsigned long)(F_CPU / 1000000u));
  int first = 0;  // after a watchdog reset: report the block that hung, carry on with the next one
  if (rp2040.getResetReason() == RP2040::WDT_RESET && watchdog_hw->scratch[1] == RESUME_MAGIC &&
      watchdog_hw->scratch[0] < N_BLOCKS) {
    first = watchdog_hw->scratch[0] + 1;
    uint32_t step = watchdog_hw->scratch[2];
    Serial.printf("#watchdog %s: hung during %s (connection %ld); no progress for 8 s, the board rebooted; "
                  "continuing with the next block\n", label(plan(first - 1)),
                  step < sizeof STEPS / sizeof *STEPS ? STEPS[step] : "?", (long)(int32_t)watchdog_hw->scratch[3]);
  } else if (watchdog_hw->scratch[1] == REBOOT_MAGIC && watchdog_hw->scratch[0] < N_BLOCKS) {
    first = watchdog_hw->scratch[0] + 1;
#ifdef MT_DEPLOY
    last_before_reboot = watchdog_hw->scratch[3];
#endif
    Serial.printf("#rebooted on purpose after %s; continuing with the next block\n", label(plan(first - 1)));
  }
  watchdog_hw->scratch[1] = 0;
  Serial.printf("#config iterations=%d warmup=%d pipe_iterations=%d messages=%d payload_B=%d schemes=%d "
                "sweep_iterations=%d sweep_warmup=%d groups=%d kex_iterations=%d kex_warmup=%d blocks=%d\n", MT_ITERS,
                MT_WARMUP, MT_PIPE_ITERS, MT_MSGS, MT_PAYLOAD, (int)NP, MT_SWEEP_ITERS, MT_SWEEP_WARMUP,
                (int)N_GROUPS, MT_KEX_ITERS, MT_KEX_WARMUP, (int)N_BLOCKS);
  kat_ok = la_kat();  // before the session keys: the vectors bring their own
  Serial.printf("#kat LoRaWAN / AES-CMAC / Ascon known-answer checks: %s\n", kat_ok ? "OK" : "FAIL");
#ifdef MT_DEPLOY  // keys, DevAddr and FCnt from flash; new ones (saved) on the first boot
  bool fs = LittleFS.begin(), restored = fs && lora_load();
  if (!restored) {
    for (int i = 0; i < 32; i++) k_app[i] = rp2040.hwrand32();
    for (int i = 0; i < 16; i++) { k_nwk[i] = rp2040.hwrand32(); k_nwk2[i] = rp2040.hwrand32(); }
    for (int i = 0; i < 4; i++) devaddr[i] = rp2040.hwrand32();
    fcnt = 0;
  }
  boot_fcnt = fcnt;
  bool saved = fs && lora_save(fcnt + FCNT_GAP);
  Serial.printf("#lora %s: devaddr=%02x%02x%02x%02x fcnt=%lu reserved=%lu%s\n", restored ? "restored from flash" : "new keys",
                devaddr[0], devaddr[1], devaddr[2], devaddr[3], (unsigned long)fcnt, (unsigned long)fcnt_reserved,
                !fs ? " (no flash filesystem: build with a LittleFS partition)" : saved ? "" : " (SAVE FAILED)");
#else
  for (int i = 0; i < 32; i++) k_app[i] = rp2040.hwrand32();
  for (int i = 0; i < 16; i++) { k_nwk[i] = rp2040.hwrand32(); k_nwk2[i] = rp2040.hwrand32(); }
#endif
  WiFi.mode(WIFI_STA);
  WiFi.noLowPowerMode();
  WiFi.begin(WIFI_SSID, WIFI_PASS);
  for (uint32_t t0 = millis(); WiFi.status() != WL_CONNECTED && millis() - t0 < 30000;) delay(100);
  if (WiFi.status() != WL_CONNECTED) Serial.println("#fatal Wi-Fi: cannot join (2.4 GHz only; check WIFI_SSID / WIFI_PASS)");
  else if (!WiFi.hostByName(BROKER, broker)) Serial.println("#fatal cannot resolve broker " BROKER);
#ifdef MT_DEPLOY
  else if (!ntp_ok()) Serial.println("#fatal NTP: no time from " NTP_SERVER " (the deployment checks need it; set NTP_SERVER)");
#endif
  else {
    Serial.printf("#wifi rssi=%ld dBm channel=%d ip=%s broker=%s\n", (long)WiFi.RSSI(),
                  WiFi.channel(), WiFi.localIP().toString().c_str(), broker.toString().c_str());
#ifndef MT_DEPLOY
    for (int i = 0; i < 4; i++) devaddr[i] = rp2040.hwrand32();
#endif
    rp2040.wdt_begin(8000);  // the RP2040's longest; reset per connection and inside every socket wait
    snprintf(topic, sizeof topic, "pqc/pipe/pico-%02x%02x%02x%02x", devaddr[0], devaddr[1], devaddr[2], devaddr[3]);
    for (cur_block = first; cur_block < N_BLOCKS; cur_block++) {
      watchdog_hw->scratch[0] = cur_block; watchdog_hw->scratch[1] = RESUME_MAGIC; STEP(S_SETUP);
      memset(g_stk, STK_PAT, sizeof g_stk);
      run_on_stack(g_stk + sizeof g_stk, run_block);
    }
    watchdog_hw->scratch[1] = 0;
  }
  Serial.println("=== done ===");
}

void loop() { rp2040.wdt_reset(); delay(1000); }
